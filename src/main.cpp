#include <Arduino.h>
#include <ArduinoOTA.h>
#include <ESPAsyncWebServer.h>
#include <PubSubClient.h>
#include <WiFi.h>

#include <IRremote.h>

#include "secrets.h"

AsyncWebServer server(80);

IRsend irsend;
WiFiClient espClient;
PubSubClient client(espClient);
long lastReconnectAttempt = 0;

unsigned int shizuka[643] = { 417, 462, 512, 355, 404, 463, 424, 442, 404, 464, 425, 25125, 3560,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 440, 404 };
unsigned int fullSpeed[643] = { 515, 362, 507, 360, 426, 442, 426, 440, 426, 441, 404, 25159, 3458,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 443, 402 };
unsigned int powerOff[643] = { 457, 435, 433, 434, 432, 435, 432, 436, 432, 435, 432, 25123, 3493,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 432, 434 };
unsigned int shizukaHot[643] = { 460, 432, 436, 432, 436, 432, 436, 432, 432, 436, 432, 25128, 3544,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 436, 460 };

struct s_command {
    char command[32];
    unsigned int* signal;
} commands[] = {
    { "shizuka", shizuka },
    { "shizukaHot", shizukaHot },
    { "fullSpeed", fullSpeed },
    { "powerOff", powerOff },
    { (char)NULL, (char)NULL }
};

void callback(char* topic, byte* payload, unsigned int length)
{
    String payload_buff;

    for (int i = 0; i < length; i++) {
        if (payload[i] != '"')
            payload_buff = payload_buff + String((char)payload[i]);
    }
    //Serial.println(payload_buff);

    for (size_t i = 0; commands[i].command != NULL; ++i) {
        if (payload_buff == String(commands[i].command)) {
            Serial.println("Send");
            Serial.println(commands[i].command);
            irsend.sendRaw(commands[i].signal, 643, 38);
        }
    }
}

boolean reconnect()
{
    if (client.connect(clientID)) {
        client.subscribe(channelName);
    }
    return client.connected();
}

void OTASetup()
{
    // Port defaults to 3232
    // ArduinoOTA.setPort(3232);

    // Hostname defaults to esp3232-[MAC]
    ArduinoOTA.setHostname("living-ac");

    // No authentication by default
    // ArduinoOTA.setPassword("admin");

    // Password can be set with it's md5 value as well
    // MD5(admin) = 21232f297a57a5a743894a0e4a801fc3
    // ArduinoOTA.setPasswordHash("21232f297a57a5a743894a0e4a801fc3");

    ArduinoOTA
        .onStart([]() {
            String type;
            if (ArduinoOTA.getCommand() == U_FLASH)
                type = "sketch";
            else // U_SPIFFS
                type = "filesystem";

            // NOTE: if updating SPIFFS this would be the place to unmount SPIFFS using SPIFFS.end()
            Serial.println("Start updating " + type);
        })
        .onEnd([]() {
            Serial.println("\nEnd");
        })
        .onProgress([](unsigned int progress, unsigned int total) {
            Serial.printf("Progress: %u%%\r", (progress / (total / 100)));
        })
        .onError([](ota_error_t error) {
            Serial.printf("Error[%u]: ", error);
            if (error == OTA_AUTH_ERROR)
                Serial.println("Auth Failed");
            else if (error == OTA_BEGIN_ERROR)
                Serial.println("Begin Failed");
            else if (error == OTA_CONNECT_ERROR)
                Serial.println("Connect Failed");
            else if (error == OTA_RECEIVE_ERROR)
                Serial.println("Receive Failed");
            else if (error == OTA_END_ERROR)
                Serial.println("End Failed");
        });

    ArduinoOTA.begin();
}

void setup()
{

    Serial.begin(9600);
    Serial.println();

    Serial.println(WiFi.macAddress());

    Serial.printf("Connecting to %s ", ssid);
    WiFi.begin(ssid, password);

    while (WiFi.status() != WL_CONNECTED) {
        delay(500);
        Serial.print(".");
    }

    client.setServer(mqttServer, mqttPort);
    client.setCallback(callback);
    lastReconnectAttempt = 0;

    Serial.println(" connected");

    server.on("/poweroff",
        HTTP_GET,
        [](AsyncWebServerRequest* request) {
            irsend.sendRaw(powerOff, 643, 38);
            request->send(200, "text/plain", "Poweroff");
        });

    server.on("/fullspeed",
        HTTP_GET,
        [](AsyncWebServerRequest* request) {
            irsend.sendRaw(fullSpeed, 643, 38);
            request->send(200, "text/plain", "FullSpeed");
        });

    server.on("/shizuka",
        HTTP_GET,
        [](AsyncWebServerRequest* request) {
            irsend.sendRaw(shizuka, 643, 38);
            request->send(200, "text/plain", "Shizuka");
        });

    OTASetup();
    server.begin();
    Serial.printf("Web server started, open %s in a web browser\n",
        WiFi.localIP().toString().c_str());
    delay(1000);
}

void loop()
{
    ArduinoOTA.handle();

    if (!client.connected()) {
        long now = millis();
        if (now - lastReconnectAttempt > 5000) {
            lastReconnectAttempt = now;
            if (reconnect()) {
                lastReconnectAttempt = 0;
            }
        }
    } else { // Connected.
        client.loop();
    }
}
